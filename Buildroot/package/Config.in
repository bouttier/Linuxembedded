## Buildroot/package/ipshow/Config.in
```kconfig
config BR2_PACKAGE_IPSHOW
	bool "ipshow (linuxembbeded competition)"
	select BR2_PACKAGE_FREETYPE
	select BR2_PACKAGE_TSLIB
	help
		http://www.linuxembedded.fr/concours/
```

## Martin/chain/minigui/Config.in
```kconfig
config BR2_PACKAGE_MINIGUI
	bool "minigui"
	select BR2_PACKAGE_FREETYPE
	select BR2_PACKAGE_TSLIB
	help
		Minimal GUI for OpenWide's mini2440 boot time competition.
		http://www.linuxembedded.fr/concours/
```
